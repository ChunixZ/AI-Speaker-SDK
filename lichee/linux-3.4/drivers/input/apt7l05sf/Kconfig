## lichee/linux-3.4/drivers/input/apt7l05sf/Kconfig
```kconfig
#
#  Apt7l05sf driver configuration
#
config  TOUCH_APT7L05SF
       tristate  "apt7l05sf touchpad driver"      
       default m 
       help
         touch pad apt7l05sf    
         
```

## lichee/linux-3.4/drivers/input/apt8l08/Kconfig
```kconfig
#
#  Apt7l05sf driver configuration
#
config  TOUCH_APT8L08
       tristate  "apt8l08 touchpad driver"      
       default m 
       help
         touch pad apt8l08    
         
```
